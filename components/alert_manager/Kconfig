## components/mqtt_client/Kconfig
```kconfig
menu "MQTT Client Configuration"

    config MQTT_BROKER_URI
        string "MQTT Broker URI"
        default "mqtt://localhost:1883"
        help
            URI of the MQTT broker (e.g., mqtt://broker.hivemq.com:1883)

    config MQTT_TASK_PRIORITY
        int "MQTT Task Priority"
        default 5
        range 1 24
        help
            Priority of the MQTT task

    config MQTT_BUFFER_SIZE
        int "MQTT Buffer Size"
        default 4096
        help
            Size of the MQTT buffer in bytes

endmenu
```
